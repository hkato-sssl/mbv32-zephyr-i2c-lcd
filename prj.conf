## CMakeLists.txt
```
# SPDX-License-Identifier: Apache-2.0

cmake_minimum_required(VERSION 3.20.0)
find_package(Zephyr REQUIRED HINTS $ENV{ZEPHYR_BASE})
project(i2c_lcd)

target_sources(app PRIVATE src/lcd_drv.c src/cmd_lcd.c)
```

## prj.conf
```kconfig
CONFIG_SHELL=y
CONFIG_I2C=y
```

## src/cmd_lcd.c
```c
#include <zephyr/kernel.h>
#include <zephyr/device.h>
#include <zephyr/drivers/i2c.h>
#include <zephyr/shell/shell.h>

#include <stdlib.h>

#include "lcd_drv.h"

static int cmd_lcd_init(const struct shell *sh, size_t argc, char **argv)
{
	return lcd_init();
}

static int cmd_lcd_str(const struct shell *sh, size_t argc, char **argv)
{
	if (argc < 3) {
		return -1;
	}

	return lcd_write_string(argv[2]);
}

static int cmd_lcd_clear(const struct shell *sh, size_t argc, char **argv)
{
	return lcd_clear();
}

static int cmd_lcd_cr(const struct shell *sh, size_t argc, char **argv)
{
	return lcd_putc('\r');
}

static int cmd_lcd_lf(const struct shell *sh, size_t argc, char **argv)
{
	return lcd_putc('\n');
}

static int cmd_lcd_cursor(const struct shell *sh, size_t argc, char **argv)
{
	int ret;

	if (argc < 3) {
		ret = -1;
	} else if (strcmp(argv[2], "on") == 0) {
		ret = lcd_display_cursor(true);
	} else if (strcmp(argv[2], "off") == 0) {
		ret = lcd_display_cursor(false);
	} else {
		ret = -1;
	}

	return ret;
}

static int cmd_lcd(const struct shell *sh, size_t argc, char **argv)
{
	static struct {
		const char *name;
		int (*func)(const struct shell *sh, size_t argc, char **argv);
	} commands[] = {
		{"init", cmd_lcd_init},
		{"str", cmd_lcd_str},
		{"clear", cmd_lcd_clear},
		{"cr", cmd_lcd_cr},
		{"lf", cmd_lcd_lf},
		{"cursor", cmd_lcd_cursor},
		{NULL, NULL} /* terminator */
	};

	int ret;
	int i;

	if (argc < 2) {
		return -1;
	}

	for (i = 0; commands[i].name != NULL; ++i) {
		if (strcmp(argv[1], commands[i].name) == 0) {
			break;
		}
	}

	if (commands[i].func != NULL) {
		ret = (commands[i].func)(sh, argc, argv);
	} else {
		ret = -1;
	}

	return ret;
}

SHELL_CMD_REGISTER(lcd, NULL, "LCD commands", cmd_lcd);
```

## src/lcd_drv.c
```c
#include <zephyr/kernel.h>
#include <zephyr/device.h>
#include <zephyr/drivers/i2c.h>

#include <stdint.h>

#define EOS '\0'
#define CR  '\r'
#define LF  '\n'

#define LCD_WIDTH  20
#define LCD_HEIGHT 4

#define SIGNAL_RS 0x01
#define SIGNAL_RW 0x02
#define SIGNAL_E  0x04
#define BACKLIGHT 0x08

#define I2C_TARGET_ADDR 0x27
#define I2C_TARGET_NODE DT_NODELABEL(axi_iic_0)

static const struct device *lcd_i2c_dev = DEVICE_DT_GET(I2C_TARGET_NODE);
static bool lcd_backlight;
static int lcd_x;
static int lcd_y;

static int expander_write(uint8_t data)
{
	int ret;

	ret = i2c_write(lcd_i2c_dev, &data, sizeof(data), I2C_TARGET_ADDR);

	return ret;
}

static int writeb(uint8_t d)
{
	int ret;

	if (lcd_backlight) {
		d |= BACKLIGHT;
	}

	ret = expander_write(d);
	if (ret < 0) {
		return ret;
	}

	d |= SIGNAL_E;
	ret = expander_write(d);
	if (ret < 0) {
		return ret;
	}
	k_usleep(1);

	d ^= SIGNAL_E;
	ret = expander_write(d);
	if (ret == 0) {
		k_usleep(50);
	}

	return ret;
}

static int write_byte(uint8_t d, bool is_instruction)
{
	int ret;
	uint8_t rs;

	rs = is_instruction ? 0 : SIGNAL_RS;

	/* Write upper nibble */
	ret = writeb((d & 0xf0) | rs);
	if (ret < 0) {
		return ret;
	}

	/* Write lower nibble */
	ret = writeb((d << 4) | rs);

	return ret;
}

static int write_instruction(uint8_t inst)
{
	int ret;

	ret = write_byte(inst, true);

	return ret;
}

static int write_data(uint8_t data)
{
	int ret;

	ret = write_byte(data, false);

	return ret;
}

int configure_4bit_mode(void)
{
	int ret;

	ret = writeb(0x30);
	if (ret < 0) {
		return ret;
	}
	k_usleep(4500);

	ret = writeb(0x30);
	if (ret < 0) {
		return ret;
	}
	k_usleep(150);

	ret = writeb(0x30);
	if (ret < 0) {
		return ret;
	}

	ret = writeb(0x20);

	return ret;
}

int lcd_init(void)
{
	int ret;

	/* Wait at least 40ms after the power supply exceeds 2.7V */
	k_msleep(50);

	lcd_backlight = true;
	lcd_x = 0;
	lcd_y = 0;

	ret = configure_4bit_mode();
	if (ret < 0) {
		return ret;
	}

	/* Function set */
	ret = write_instruction(0x28);
	if (ret < 0) {
		return ret;
	}

	/* Display on */
	ret = write_instruction(0x0e);
	if (ret < 0) {
		return ret;
	}

	/* Display clear */
	ret = write_instruction(0x01);
	if (ret < 0) {
		return ret;
	}

	/* Entry mode set */
	ret = write_instruction(0x06);
	if (ret < 0) {
		return ret;
	}

	return ret;
}

int lcd_clear(void)
{
	int ret;

	lcd_x = 0;
	lcd_y = 0;

	/* Clear display */
	ret = write_instruction(0x01);

	return ret;
}

static int update_cursor_position(void)
{
	static uint8_t offset[] = {0, 0x40, LCD_WIDTH, 0x40 + LCD_WIDTH};

	int ret;
	uint8_t d;

	/* Set DDRAM address */
	d = 0x80 | (offset[lcd_y] + lcd_x);
	ret = write_instruction(d);

	return ret;
}

int lcd_putc(int ch)
{
	int ret;

	if (ch == CR) {
		lcd_x = 0;
		ret = update_cursor_position();
	} else if (ch == LF) {
		lcd_x = 0;
		++lcd_y;
		if (lcd_y >= LCD_HEIGHT) {
			lcd_y = 0;
		}
		ret = update_cursor_position();
	} else {
		ret = write_data(ch);
		if (ret != 0) {
			return ret;
		}

		++lcd_x;
		if (lcd_x >= LCD_WIDTH) {
			lcd_x = 0;
			++lcd_y;
			if (lcd_y >= LCD_HEIGHT) {
				lcd_y = 0;
			}
			ret = update_cursor_position();
		}
	}

	return ret;
}

int lcd_write_string(const char *str)
{
	int ret = -1;

	for (int i = 0; str[i] != EOS; ++i) {
		ret = lcd_putc(str[i]);
		if (ret < 0) {
			break;
		}
	}

	return ret;
}

int lcd_display_cursor(bool fg)
{
	int ret;
	uint8_t d;

	/* Display on/off control */
	d = fg ? 0x0e : 0x0c;
	ret = write_instruction(d);

	return ret;
}
```

## src/lcd_drv.h
```c
#ifndef LCD_H
#define LCD_H

#ifdef __cplusplus
extern "C" {
#endif

int lcd_init(void);
int lcd_clear(void);
int lcd_putc(int ch);
int lcd_write_string(const char *str);
int lcd_display_cursor(bool fg);

#ifdef __cplusplus
}
#endif

#endif /* LCD_H */
```
